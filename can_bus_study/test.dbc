VERSION ""
NS_ :

BS_:

BU_:

BO_ 2022 CHEN_TEST: 8 Vector__XXX
 SG_ TEST_CHEN1 : 0|32@1+ (1,0) [0|65535] "m/s" Vector__XXX
 SG_ TEST_CHEN2 : 32|32@1+ (1,0) [0|65535] "km" Vector__XXX
